## platforms/esp32-p4-wifi6-touch-lcd/bootloader_components/main/Kconfig
```kconfig
choice SPECTER_ROOT_VALIDATION_TARGET
    prompt "Application placement target"
    default SPECTER_ROOT_VALIDATION_TARGET_BOOT_A
    help
        Select where idf.py places the application artifact. Root Loader
        runtime selection always uses approval, request, and trial state.

    config SPECTER_ROOT_VALIDATION_TARGET_BOOT_A
        bool "boot_a"

    config SPECTER_ROOT_VALIDATION_TARGET_BOOT_B
        bool "boot_b"

    config SPECTER_ROOT_VALIDATION_TARGET_MAIN
        bool "main"
endchoice

config SPECTER_E2E_TEST_HOOKS
    bool "Enable one-shot plaintext development fault hooks"
    default n
    depends on !SECURE_BOOT && !SECURE_FLASH_ENC_ENABLED
    help
        Reserved for hardware testing. A CRC-checked fixture at 0x622000
        selects one boundary; the hook consumes it and pauses for ten seconds.
        The test harness must reserve and restore that otherwise unused sector.
        Never enable this in release firmware.
```

## platforms/esp32-p4-wifi6-touch-lcd/main/Kconfig.projbuild
```kconfig
choice SPECTER_BOARD
    prompt "Waveshare ESP32-P4 Touch LCD board"
    default SPECTER_BOARD_LCD_4P3

    config SPECTER_BOARD_LCD_4P3
        bool "ESP32-P4-WIFI6-Touch-LCD-4.3"

    config SPECTER_BOARD_LCD_5
        bool "ESP32-P4-WIFI6-Touch-LCD-5"
endchoice

config SPECTER_UI_HARDWARE_DIAGNOSTIC
    bool "Run the display, backlight, and touch diagnostic at startup"
    default n
    help
        Exercise the Phase 6 UI on development hardware before normal
        bootloader processing. Never enable this in a release configuration.
```

## platforms/esp32-p4-wifi6-touch-lcd/sd_uploader/main/Kconfig.projbuild
```kconfig
choice SDU_BOARD
    prompt "Uploader board"
    default SDU_BOARD_4P3
config SDU_BOARD_4P3
    bool "lcd-4p3"
config SDU_BOARD_5
    bool "lcd-5"
endchoice

config SDU_UART_BAUD
    int "Uploader UART baud (ROM download starts at 115200)"
    range 115200 4000000
    default 4000000
```

## platforms/esp32-p4-wifi6-touch-lcd/sd_uploader/sdkconfig.defaults
```kconfig
CONFIG_APP_BUILD_TYPE_RAM=y
CONFIG_APP_BUILD_TYPE_PURE_RAM_APP=y
CONFIG_ESP32P4_SELECTS_REV_LESS_V3=y
CONFIG_ESP32P4_REV_MIN_100=y
CONFIG_CACHE_L2_CACHE_128KB=y
CONFIG_COMPILER_OPTIMIZATION_SIZE=y
CONFIG_LIBC_NEWLIB_NANO_FORMAT=y
CONFIG_ESP_SYSTEM_PANIC_PRINT_HALT=y
CONFIG_ESP_ERR_TO_NAME_LOOKUP=n
CONFIG_ESP_MAIN_TASK_STACK_SIZE=12288
CONFIG_ESP_CONSOLE_UART_DEFAULT=y
CONFIG_ESP_CONSOLE_UART_BAUDRATE=115200
CONFIG_LOG_DEFAULT_LEVEL_NONE=y
CONFIG_FATFS_LFN_HEAP=y
CONFIG_FATFS_MAX_LFN=128
CONFIG_FATFS_CODEPAGE_437=y
CONFIG_FATFS_FS_LOCK=4
CONFIG_FATFS_VOLUME_COUNT=1
CONFIG_FATFS_USE_FASTSEEK=n
CONFIG_FATFS_PER_FILE_CACHE=y
CONFIG_MBEDTLS_HARDWARE_SHA=n
CONFIG_ESP_TASK_WDT_EN=n

CONFIG_ESP_SYSTEM_PMP_IDRAM_SPLIT=n
CONFIG_ESP_CONSOLE_SECONDARY_NONE=y
CONFIG_ESP_SYSTEM_ALLOW_RTC_FAST_MEM_AS_HEAP=n
```

## platforms/esp32-p4-wifi6-touch-lcd/sdkconfig.defaults.layout.in
```kconfig
CONFIG_PARTITION_TABLE_CUSTOM_FILENAME="@SPECTER_PARTITION_CSV@"
CONFIG_PARTITION_TABLE_FILENAME="@SPECTER_PARTITION_CSV@"
```
